## backports/Kconfig
```kconfig
config BACKPORT_INTEGRATE
	bool
	def_bool y

config BACKPORT_DIR
	string
	default "backports/"

config BACKPORT_VERSION
	string
	default "backports-20141221-0-g69e3442"

config BACKPORT_KERNEL_VERSION
	string
	default "next-20141221-0-gf9f7b9d"

config BACKPORT_KERNEL_NAME
	string
	default "Linux"

menuconfig BACKPORT_LINUX
	bool "Backport Linux next-20141221-0-gf9f7b9d (backports backports-20141221-0-g69e3442)"
	default n
	---help---
	  Enabling this will let give you the opportunity to use features and
	  drivers backported from Linux next-20141221-0-gf9f7b9d
	  on the kernel your are using. This is experimental and you should
	  say no unless you'd like to help test things or want to help debug
	  this should we run into any issues.

if BACKPORT_LINUX

source "$BACKPORT_DIR/Kconfig.versions"
source "$BACKPORT_DIR/Kconfig.sources"

endif # BACKPORT_LINUX
```

## backports/net/bluetooth/Kconfig
```kconfig
#
# Bluetooth subsystem configuration
#

menuconfig BACKPORT_BT
	tristate "Bluetooth subsystem support"
	depends on !BT
	depends on NET && !S390
	depends on RFKILL || !RFKILL
	depends on CRC16
	depends on CRYPTO
	depends on CRYPTO_BLKCIPHER
	depends on CRYPTO_AES
	depends on CRYPTO_CMAC
	depends on CRYPTO_ECB
	depends on CRYPTO_SHA256
	help
	  Bluetooth is low-cost, low-power, short-range wireless technology.
	  It was designed as a replacement for cables and other short-range
	  technologies like IrDA.  Bluetooth operates in personal area range
	  that typically extends up to 10 meters.  More information about
	  Bluetooth can be found at <http://www.bluetooth.com/>.

	  Linux Bluetooth subsystem consist of several layers:
	     Bluetooth Core
		HCI device and connection manager, scheduler
		SCO audio links
		L2CAP (Logical Link Control and Adaptation Protocol)
		SMP (Security Manager Protocol) on LE (Low Energy) links
	     HCI Device drivers (Interface to the hardware)
	     RFCOMM Module (RFCOMM Protocol)  
	     BNEP Module (Bluetooth Network Encapsulation Protocol)
	     CMTP Module (CAPI Message Transport Protocol)
	     HIDP Module (Human Interface Device Protocol)

	  Say Y here to compile Bluetooth support into the kernel or say M to
	  compile it as module (bluetooth).

	  To use Linux Bluetooth subsystem, you will need several user-space
	  utilities like hciconfig and bluetoothd.  These utilities and updates
	  to Bluetooth kernel modules are provided in the BlueZ packages.  For
	  more information, see <http://www.bluez.org/>.

config BACKPORT_BT_BREDR
	bool "Bluetooth Classic (BR/EDR) features"
	depends on !BT_BREDR
	depends on BACKPORT_BT
	default y

source "$BACKPORT_DIR/net/bluetooth/rfcomm/Kconfig"

source "$BACKPORT_DIR/net/bluetooth/bnep/Kconfig"

source "$BACKPORT_DIR/net/bluetooth/cmtp/Kconfig"

source "$BACKPORT_DIR/net/bluetooth/hidp/Kconfig"

config BACKPORT_BT_LE
	bool "Bluetooth Low Energy (LE) features"
	depends on !BT_LE
	depends on BACKPORT_BT
	default y

config BACKPORT_BT_6LOWPAN
	tristate "Bluetooth 6LoWPAN support"
	depends on !BT_6LOWPAN
	depends on BACKPORT_BT_LE && 6LOWPAN
	help
	  IPv6 compression over Bluetooth Low Energy.

source "$BACKPORT_DIR/drivers/bluetooth/Kconfig"
```
